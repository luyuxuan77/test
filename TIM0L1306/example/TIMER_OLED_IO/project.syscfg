/**
 * @cliArgs --device "MSPM0L130X" --package "VQFN-32(RHB)" --part "Default" --product "mspm0_sdk@1.20.01.06"
 * @versions {"tool":"1.18.1+3343"}
 */

/**
 * Import the modules used in this configuration.
 */
const Board  = scripting.addModule("/ti/driverlib/Board");
const GPIO   = scripting.addModule("/ti/driverlib/GPIO", {}, false);
const GPIO1  = GPIO.addInstance();
const GPIO2  = GPIO.addInstance();
const GPIO3  = GPIO.addInstance();
const SYSCTL = scripting.addModule("/ti/driverlib/SYSCTL");
const TIMER  = scripting.addModule("/ti/driverlib/TIMER", {}, false);
const TIMER1 = TIMER.addInstance();

/**
 * Write custom configuration values to the imported modules.
 */
const gate6  = system.clockTree["MFCLKGATE"];
gate6.enable = true;

const gate7  = system.clockTree["MFPCLKGATE"];
gate7.enable = true;


GPIO1.$name                         = "GPIO_GRP_0";
GPIO1.associatedPins.create(4);
GPIO1.associatedPins[0].$name       = "CS";
GPIO1.associatedPins[0].assignedPin = "2";
GPIO1.associatedPins[1].$name       = "DC";
GPIO1.associatedPins[1].assignedPin = "4";
GPIO1.associatedPins[2].$name       = "D0";
GPIO1.associatedPins[2].assignedPin = "6";
GPIO1.associatedPins[3].$name       = "D1";
GPIO1.associatedPins[3].assignedPin = "5";

GPIO2.$name                         = "SWITCH";
GPIO2.associatedPins[0].$name       = "PIN_0";
GPIO2.associatedPins[0].direction   = "INPUT";
GPIO2.associatedPins[0].assignedPin = "1";
GPIO2.associatedPins[0].interruptEn = true;
GPIO2.associatedPins[0].polarity    = "FALL";
GPIO2.associatedPins[0].pin.$assign = "PA1";

GPIO3.$name                          = "LED";
GPIO3.associatedPins[0].$name        = "PIN_1";
GPIO3.associatedPins[0].assignedPin  = "8";
GPIO3.associatedPins[0].initialValue = "SET";

SYSCTL.MFCLKEn     = true;
SYSCTL.MFPCLKEn    = true;
SYSCTL.clockTreeEn = true;

TIMER1.$name            = "TIMER_0";
TIMER1.timerClkPrescale = 100;
TIMER1.timerPeriod      = "10ms";
TIMER1.interrupts       = ["ZERO"];
TIMER1.timerMode        = "PERIODIC";

/**
 * Pinmux solution for unlocked pins/peripherals. This ensures that minor changes to the automatic solver in a future
 * version of the tool will not impact the pinmux you originally saw.  These lines can be completely deleted in order to
 * re-solve from scratch.
 */
Board.peripheral.$suggestSolution            = "DEBUGSS";
Board.peripheral.swclkPin.$suggestSolution   = "PA20";
Board.peripheral.swdioPin.$suggestSolution   = "PA19";
GPIO1.associatedPins[0].pin.$suggestSolution = "PA2";
GPIO1.associatedPins[1].pin.$suggestSolution = "PA4";
GPIO1.associatedPins[2].pin.$suggestSolution = "PA6";
GPIO1.associatedPins[3].pin.$suggestSolution = "PA5";
GPIO3.associatedPins[0].pin.$suggestSolution = "PA8";
TIMER1.peripheral.$suggestSolution           = "TIMG0";
