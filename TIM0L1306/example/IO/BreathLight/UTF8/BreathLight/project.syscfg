/**
 * @cliArgs --device "MSPM0L130X" --package "VQFN-32(RHB)" --part "Default" --product "mspm0_sdk@1.20.01.06"
 * @versions {"tool":"1.18.1+3343"}
 */

/**
 * Import the modules used in this configuration.
 */
const Board  = scripting.addModule("/ti/driverlib/Board");
const PWM    = scripting.addModule("/ti/driverlib/PWM", {}, false);
const PWM1   = PWM.addInstance();
const SYSCTL = scripting.addModule("/ti/driverlib/SYSCTL");
const TIMER  = scripting.addModule("/ti/driverlib/TIMER", {}, false);
const TIMER1 = TIMER.addInstance();

/**
 * Write custom configuration values to the imported modules.
 */
const gate6  = system.clockTree["MFCLKGATE"];
gate6.enable = true;

const gate7  = system.clockTree["MFPCLKGATE"];
gate7.enable = true;


PWM1.$name                      = "PWM_0";
PWM1.ccIndex                    = [0];
PWM1.timerStartTimer            = true;
PWM1.clockSource                = "MFCLK";
PWM1.timerCount                 = 256;
PWM1.pwmMode                    = "EDGE_ALIGN_UP";
PWM1.peripheral.ccp0Pin.$assign = "PA8";
PWM1.PWM_CHANNEL_0.$name        = "ti_driverlib_pwm_PWMTimerCC0";
PWM1.PWM_CHANNEL_0.invert       = true;
PWM1.ccp0PinConfig.$name        = "ti_driverlib_gpio_GPIOPinGeneric0";

SYSCTL.MFCLKEn     = true;
SYSCTL.MFPCLKEn    = true;
SYSCTL.clockTreeEn = true;

TIMER1.$name           = "TIMER_0";
TIMER1.timerPeriod     = "3.90625ms";
TIMER1.timerClkSrc     = "LFCLK";
TIMER1.timerStartTimer = true;
TIMER1.timerMode       = "PERIODIC_UP";
TIMER1.interrupts      = ["ZERO"];

/**
 * Pinmux solution for unlocked pins/peripherals. This ensures that minor changes to the automatic solver in a future
 * version of the tool will not impact the pinmux you originally saw.  These lines can be completely deleted in order to
 * re-solve from scratch.
 */
Board.peripheral.$suggestSolution          = "DEBUGSS";
Board.peripheral.swclkPin.$suggestSolution = "PA20";
Board.peripheral.swdioPin.$suggestSolution = "PA19";
PWM1.peripheral.$suggestSolution           = "TIMG2";
TIMER1.peripheral.$suggestSolution         = "TIMG0";
